## app/dts/bindings/behaviors/zmk,behavior-sensor-rotate-accel.yaml
```yaml
# Copyright (c) 2026 LiNEA40 contributors
# SPDX-License-Identifier: MIT

description: Rotation-rate-sensitive sensor behavior

compatible: "zmk,behavior-sensor-rotate-accel"

properties:
  label:
    type: string
    required: false
    deprecated: true
  "#sensor-binding-cells":
    type: int
    required: true
    const: 2
  bindings:
    type: phandles
    required: true
  tap-ms:
    type: int
    default: 20
  direction-confirm-ms:
    type: int
    default: 75
  slow-interval-ms:
    type: int
    default: 120
  fast-interval-ms:
    type: int
    default: 25
  fast-trigger-count:
    type: int
    default: 3
  slow-scale-percent:
    type: int
    default: 21
  fast-scale-percent:
    type: int
    default: 50

sensor-binding-cells:
  - param1
  - param2
```
